## CMakeLists.txt
```
#-------------------------------------------------------------------------------
# Zephyr Example Application
#
# Copyright (c) 2021 Nordic Semiconductor ASA
# SPDX-License-Identifier: Apache-2.0

cmake_minimum_required(VERSION 3.13.1)
find_package(Zephyr REQUIRED HINTS $ENV{ZEPHYR_BASE})

project(app LANGUAGES C)

target_sources(app PRIVATE
    src/main.c
    src/diagnostic_log.c
    src/power_monitor.c
    src/settings.c
)
```

## Kconfig
```
# Copyright (c) 2021 Nordic Semiconductor ASA
# SPDX-License-Identifier: Apache-2.0
#
# This file is the application Kconfig entry point. All application Kconfig
# options can be defined here or included via other application Kconfig files.
# You can browse these options using the west targets menuconfig (terminal) or
# guiconfig (GUI).

menu "Zephyr"
source "Kconfig.zephyr"
endmenu

module = APP
module-str = APP
source "subsys/logging/Kconfig.template.log_config"

config TRACKER_PROVISIONING_MODE
	bool "Tracker serial provisioning mode"
	help
	  Disable the normal tracker runtime so a shell build can safely write
	  persistent provisioning settings without the LoRaWAN stack joining or
	  updating its NVM state at the same time.

config TRACKER_DIAGNOSTIC_LOG
	bool "Tracker diagnostic flash log"
	default y
	depends on FLASH && FLASH_MAP
	help
	  Store compact binary diagnostic records in the diagnostic-log flash
	  partition. This is intended for field testing and offline decoding, not
	  for raw text log storage.
```

## sample.yaml
```
# This file is provided so that the application can be compiled using Twister,
# the Zephyr testing tool. In this file, multiple combinations can be specified,
# so that you can easily test all of them locally or in CI.
sample:
  description: Example application
  name: example-application 
common:
  build_only: true
  integration_platforms:
    - custom_plank
    - nucleo_f302r8
    - trackerd_ls
tests:
  app.default: {}
  app.debug:
    extra_overlay_confs:
      - debug.conf
```

## prj.conf
```kconfig
CONFIG_LOG=y
# Keep UART read-only; shell RX echo can turn line noise into console garbage.
CONFIG_LOG_BACKEND_UART=y
CONFIG_LED_STATUS=y

CONFIG_EARLY_CONSOLE=y
CONFIG_STDOUT_CONSOLE=y
CONFIG_UART_INTERRUPT_DRIVEN=y

CONFIG_INIT_STACKS=y
CONFIG_MAIN_STACK_SIZE=5200
CONFIG_SYSTEM_WORKQUEUE_STACK_SIZE=4096
CONFIG_ISR_STACK_SIZE=4096

CONFIG_WATCHDOG=y
CONFIG_TASK_WDT=y

CONFIG_FLASH=y
CONFIG_FLASH_MAP=y
CONFIG_SETTINGS=y
CONFIG_SETTINGS_RUNTIME=y
CONFIG_NVS=y
CONFIG_SETTINGS_NVS=y

CONFIG_GNSS=y
CONFIG_APP_GNSS_LOG_LEVEL_DBG=y

CONFIG_LORA=y
CONFIG_LORAWAN=y
CONFIG_LORAWAN_REGION_EU868=y
CONFIG_LORAWAN_LOG_LEVEL_DBG=y
CONFIG_APP_LORAWAN_NODE_LOG_LEVEL_DBG=y

#CONFIG_NETWORKING=y
#CONFIG_NET_HOSTNAME_ENABLE=y
#CONFIG_NET_HOSTNAME="tracker"
#CONFIG_NET_HOSTNAME_DYNAMIC=y
#CONFIG_NET_CONNECTION_MANAGER=y
#CONFIG_TEST_RANDOM_GENERATOR=y
#
#CONFIG_NET_PKT_RX_COUNT=10
#CONFIG_NET_PKT_TX_COUNT=10
#CONFIG_NET_BUF_RX_COUNT=20
#CONFIG_NET_BUF_TX_COUNT=20
#CONFIG_NET_MAX_CONTEXTS=10
#CONFIG_NET_DHCPV4=y
#
#CONFIG_NET_IPV4=y
#CONFIG_NET_IPV6=n
#
#CONFIG_NET_TCP=y
#
#CONFIG_NET_LOG=y
#
#CONFIG_NET_SHELL=y
#
#CONFIG_NET_STATISTICS=y
#CONFIG_NET_STATISTICS_PERIODIC_OUTPUT=n
#
#CONFIG_WIFI=y
#CONFIG_WIFI_NM=y
#CONFIG_WIFI_NM_MAX_MANAGED_INTERFACES=2
#CONFIG_WIFI_LOG_LEVEL_ERR=y
#CONFIG_NET_L2_WIFI_SHELL=y
## printing of scan results puts pressure on queues in new locking
## design in net_mgmt. So, use a higher timeout for a crowded
## environment.
#CONFIG_NET_MGMT_EVENT_QUEUE_TIMEOUT=5000
#CONFIG_NET_MGMT_EVENT_QUEUE_SIZE=16
```

## provisioning.conf
```kconfig
# Temporary provisioning build only.
#
# The production/default firmware keeps the UART read-only. This overlay enables
# a serial shell with the app-specific `tracker provision` command so LoRaWAN
# identity settings can be written to NVS without compiling credentials into
# the image.

CONFIG_TRACKER_PROVISIONING_MODE=y

CONFIG_SHELL=y
CONFIG_SHELL_BACKEND_SERIAL=y
CONFIG_SHELL_CMD_BUFF_SIZE=160
CONFIG_SHELL_ECHO_STATUS=n
CONFIG_SHELL_HISTORY=n

# Avoid competing UART log and shell backends in the provisioning build.
CONFIG_LOG_BACKEND_UART=n
CONFIG_SHELL_LOG_BACKEND=y
```

## src/diagnostic_log.c
```c
#include <errno.h>
#include <stddef.h>
#include <string.h>

#include <zephyr/device.h>
#include <zephyr/devicetree.h>
#include <zephyr/kernel.h>
#include <zephyr/logging/log.h>
#include <zephyr/storage/flash_map.h>
#include <zephyr/sys/util.h>

#include <app/diagnostic_log.h>

LOG_MODULE_REGISTER(diagnostic_log, CONFIG_APP_LOG_LEVEL);

#define DIAGNOSTIC_LOG_MAGIC 0xd107U
#define DIAGNOSTIC_LOG_VERSION 7U
#define DIAGNOSTIC_LOG_MIN_COMPAT_VERSION 6U
#define DIAGNOSTIC_LOG_RECORD_SIZE 48U
#define DIAGNOSTIC_LOG_SECTOR_SIZE 4096U

struct diagnostic_log_record {
	uint16_t magic;
	uint8_t version;
	uint8_t record_size;
	uint32_t seq;
	uint32_t uptime_ms;
	uint32_t utc_packed;
	int32_t latitude;
	int32_t longitude;
	uint16_t speed_cm_s;
	uint16_t hdop;
	uint16_t interval_s;
	int16_t send_ret;
	uint8_t motion_state;
	uint8_t result;
	uint8_t satellites;
	uint8_t flags;
	uint8_t lorawan_dr;
	uint8_t link_flags;
	int16_t downlink_rssi;
	int8_t downlink_snr;
	uint8_t power_flags;
	uint16_t battery_mv;
	uint16_t battery_pin_mv;
	uint16_t crc16;
} __attribute__((packed));

BUILD_ASSERT(sizeof(struct diagnostic_log_record) == DIAGNOSTIC_LOG_RECORD_SIZE);

#if IS_ENABLED(CONFIG_TRACKER_DIAGNOSTIC_LOG)

#define DIAGNOSTIC_LOG_PARTITION_NODE DT_NODELABEL(diagnostic_log_partition)

BUILD_ASSERT(DT_NODE_EXISTS(DIAGNOSTIC_LOG_PARTITION_NODE),
	     "diagnostic_log_partition is required when CONFIG_TRACKER_DIAGNOSTIC_LOG=y");
BUILD_ASSERT((DT_REG_SIZE(DIAGNOSTIC_LOG_PARTITION_NODE) % DIAGNOSTIC_LOG_SECTOR_SIZE) == 0);

#define DIAGNOSTIC_LOG_AREA_ID PARTITION_ID(diagnostic_log_partition)
#define DIAGNOSTIC_LOG_PARTITION_SIZE DT_REG_SIZE(DIAGNOSTIC_LOG_PARTITION_NODE)
#define DIAGNOSTIC_LOG_SECTOR_COUNT \
	(DIAGNOSTIC_LOG_PARTITION_SIZE / DIAGNOSTIC_LOG_SECTOR_SIZE)
#define DIAGNOSTIC_LOG_RECORDS_PER_SECTOR \
	(DIAGNOSTIC_LOG_SECTOR_SIZE / DIAGNOSTIC_LOG_RECORD_SIZE)
#define DIAGNOSTIC_LOG_RECORD_CAPACITY \
	(DIAGNOSTIC_LOG_SECTOR_COUNT * DIAGNOSTIC_LOG_RECORDS_PER_SECTOR)

K_MUTEX_DEFINE(diagnostic_log_mutex);

static const struct flash_area *diagnostic_log_area;
static bool diagnostic_log_ready;
static uint32_t diagnostic_log_write_index;
static uint32_t diagnostic_log_next_seq;

static uint16_t diagnostic_log_crc16(const uint8_t *data, size_t len)
{
	uint16_t crc = 0xffffU;

	for (size_t i = 0; i < len; i++) {
		crc ^= (uint16_t)data[i] << 8;
		for (int bit = 0; bit < 8; bit++) {
			if ((crc & 0x8000U) != 0U) {
				crc = (crc << 1) ^ 0x1021U;
			} else {
				crc <<= 1;
			}
		}
	}

	return crc;
}

static bool diagnostic_log_record_is_erased(const uint8_t *data, size_t len)
{
	for (size_t i = 0; i < len; i++) {
		if (data[i] != 0xffU) {
			return false;
		}
	}

	return true;
}

static bool diagnostic_log_record_is_valid(const struct diagnostic_log_record *record)
{
	uint16_t crc;

	if (record->magic != DIAGNOSTIC_LOG_MAGIC ||
	    record->version < DIAGNOSTIC_LOG_MIN_COMPAT_VERSION ||
	    record->version > DIAGNOSTIC_LOG_VERSION ||
	    record->record_size != DIAGNOSTIC_LOG_RECORD_SIZE) {
		return false;
	}

	crc = diagnostic_log_crc16((const uint8_t *)record,
				   offsetof(struct diagnostic_log_record, crc16));

	return record->crc16 == crc;
}

static uint32_t diagnostic_log_offset_for_index(uint32_t index)
{
	uint32_t sector = index / DIAGNOSTIC_LOG_RECORDS_PER_SECTOR;
	uint32_t slot = index % DIAGNOSTIC_LOG_RECORDS_PER_SECTOR;

	return (sector * DIAGNOSTIC_LOG_SECTOR_SIZE) +
	       (slot * DIAGNOSTIC_LOG_RECORD_SIZE);
}

static int diagnostic_log_erase_sector(uint32_t sector)
{
	return flash_area_erase(diagnostic_log_area,
				sector * DIAGNOSTIC_LOG_SECTOR_SIZE,
				DIAGNOSTIC_LOG_SECTOR_SIZE);
}

static uint32_t diagnostic_log_sector_for_index(uint32_t index)
{
	return index / DIAGNOSTIC_LOG_RECORDS_PER_SECTOR;
}

static uint32_t diagnostic_log_first_index_in_sector(uint32_t sector)
{
	return sector * DIAGNOSTIC_LOG_RECORDS_PER_SECTOR;
}

static int diagnostic_log_prepare_write_slot(void)
{
	struct diagnostic_log_record record;
	uint32_t offset;
	uint32_t sector;
	uint32_t slot;
	int ret;

	offset = diagnostic_log_offset_for_index(diagnostic_log_write_index);
	ret = flash_area_read(diagnostic_log_area, offset, &record, sizeof(record));
	if (ret != 0) {
		return ret;
	}

	if (diagnostic_log_record_is_erased((const uint8_t *)&record, sizeof(record))) {
		return 0;
	}

	sector = diagnostic_log_sector_for_index(diagnostic_log_write_index);
	slot = diagnostic_log_write_index % DIAGNOSTIC_LOG_RECORDS_PER_SECTOR;

	if (slot != 0U) {
		sector = (sector + 1U) % DIAGNOSTIC_LOG_SECTOR_COUNT;
		diagnostic_log_write_index = diagnostic_log_first_index_in_sector(sector);
	}

	return diagnostic_log_erase_sector(sector);
}

int diagnostic_log_init(void)
{
	struct diagnostic_log_record record;
	bool have_record = false;
	uint32_t latest_seq = 0U;
	uint32_t latest_index = 0U;
	int ret;

	ret = flash_area_open(DIAGNOSTIC_LOG_AREA_ID, &diagnostic_log_area);
	if (ret != 0) {
		LOG_WRN("diagnostic log flash area open failed: %d", ret);
		return ret;
	}

	for (uint32_t index = 0U; index < DIAGNOSTIC_LOG_RECORD_CAPACITY; index++) {
		uint32_t offset = diagnostic_log_offset_for_index(index);

		ret = flash_area_read(diagnostic_log_area, offset, &record, sizeof(record));
		if (ret != 0) {
			LOG_WRN("diagnostic log scan failed at 0x%x: %d", offset, ret);
			return ret;
		}

		if (!diagnostic_log_record_is_valid(&record)) {
			continue;
		}

		if (!have_record || record.seq > latest_seq) {
			have_record = true;
			latest_seq = record.seq;
			latest_index = index;
		}
	}

	if (have_record) {
		diagnostic_log_next_seq = latest_seq + 1U;
		diagnostic_log_write_index = (latest_index + 1U) %
					     DIAGNOSTIC_LOG_RECORD_CAPACITY;
	} else {
		diagnostic_log_next_seq = 0U;
		diagnostic_log_write_index = 0U;
	}

	diagnostic_log_ready = true;
	LOG_INF("diagnostic log ready: %u KiB, %u records, next seq %u",
		DIAGNOSTIC_LOG_PARTITION_SIZE / 1024U,
		DIAGNOSTIC_LOG_RECORD_CAPACITY,
		diagnostic_log_next_seq);

	return 0;
}

int diagnostic_log_write_uplink(const struct diagnostic_log_uplink_entry *entry)
{
	struct diagnostic_log_record record = {0};
	uint32_t offset;
	int ret;

	if (!diagnostic_log_ready || entry == NULL) {
		return -ENODEV;
	}

	k_mutex_lock(&diagnostic_log_mutex, K_FOREVER);

	ret = diagnostic_log_prepare_write_slot();
	if (ret != 0) {
		LOG_WRN("diagnostic log write slot prepare failed: %d", ret);
		goto out;
	}

	record.magic = DIAGNOSTIC_LOG_MAGIC;
	record.version = DIAGNOSTIC_LOG_VERSION;
	record.record_size = DIAGNOSTIC_LOG_RECORD_SIZE;
	record.seq = diagnostic_log_next_seq;
	record.uptime_ms = entry->uptime_ms;
	record.utc_packed = entry->utc_packed;
	record.latitude = entry->latitude;
	record.longitude = entry->longitude;
	record.speed_cm_s = entry->speed_cm_s;
	record.hdop = entry->hdop;
	record.interval_s = entry->interval_s;
	record.send_ret = entry->send_ret;
	record.motion_state = entry->motion_state;
	record.result = entry->result;
	record.satellites = entry->satellites;
	record.flags = entry->flags;
	record.lorawan_dr = entry->lorawan_dr;
	record.link_flags = entry->link_flags;
	record.downlink_rssi = entry->downlink_rssi;
	record.downlink_snr = entry->downlink_snr;
	record.power_flags = entry->power_flags;
	record.battery_mv = entry->battery_mv;
	record.battery_pin_mv = entry->battery_pin_mv;
	record.crc16 = diagnostic_log_crc16((const uint8_t *)&record,
					    offsetof(struct diagnostic_log_record, crc16));

	offset = diagnostic_log_offset_for_index(diagnostic_log_write_index);
	ret = flash_area_write(diagnostic_log_area, offset, &record, sizeof(record));
	if (ret != 0) {
		LOG_WRN("diagnostic log write failed at 0x%x: %d", offset, ret);
		goto out;
	}

	diagnostic_log_next_seq++;
	diagnostic_log_write_index = (diagnostic_log_write_index + 1U) %
				     DIAGNOSTIC_LOG_RECORD_CAPACITY;

out:
	k_mutex_unlock(&diagnostic_log_mutex);
	return ret;
}

#else

int diagnostic_log_init(void)
{
	return 0;
}

int diagnostic_log_write_uplink(const struct diagnostic_log_uplink_entry *entry)
{
	ARG_UNUSED(entry);

	return 0;
}

#endif

uint32_t diagnostic_log_pack_utc(const struct gnss_time *utc)
{
	uint32_t second;

	if (utc == NULL) {
		return 0U;
	}

	second = utc->millisecond / 1000U;

	if (utc->century_year > 63U || utc->month < 1U || utc->month > 12U ||
	    utc->month_day < 1U || utc->month_day > 31U ||
	    utc->hour > 23U || utc->minute > 59U || second > 59U) {
		return 0U;
	}

	return ((uint32_t)utc->century_year << 26) |
	       ((uint32_t)utc->month << 22) |
	       ((uint32_t)utc->month_day << 17) |
	       ((uint32_t)utc->hour << 12) |
	       ((uint32_t)utc->minute << 6) |
	       second;
}
```

## src/power_monitor.c
```c
#include <errno.h>
#include <stdint.h>
#include <string.h>

#include <esp_clk_tree.h>
#include <esp_adc/adc_cali.h>
#include <esp_adc/adc_cali_scheme.h>
#include <esp_err.h>
#include <esp_private/sar_periph_ctrl.h>
#include <hal/adc_hal_common.h>
#include <hal/adc_oneshot_hal.h>
#include <soc/soc_caps.h>

#include <zephyr/logging/log.h>
#include <zephyr/sys/util.h>

#include <app/power_monitor.h>

LOG_MODULE_REGISTER(power_monitor, CONFIG_APP_LOG_LEVEL);

#define BATTERY_ADC_UNIT ADC_UNIT_1
#define BATTERY_ADC_CHANNEL ADC_CHANNEL_6
#define BATTERY_ADC_ATTEN ADC_ATTEN_DB_12
#define BATTERY_ADC_BITWIDTH ADC_BITWIDTH_12
#define BATTERY_ADC_DEFAULT_VREF_MV 1100
#define BATTERY_DIVIDER_HIGH_KOHM 100
#define BATTERY_DIVIDER_LOW_KOHM 470
#define BATTERY_DIVIDER_NUMERATOR \
	(BATTERY_DIVIDER_HIGH_KOHM + BATTERY_DIVIDER_LOW_KOHM)
#define BATTERY_DIVIDER_DENOMINATOR BATTERY_DIVIDER_LOW_KOHM

static adc_oneshot_hal_ctx_t battery_adc_hal;
static adc_cali_handle_t battery_adc_cali;
static bool battery_ready;
static bool battery_calibrated;

static int esp_err_to_errno(esp_err_t err)
{
	switch (err) {
	case ESP_OK:
		return 0;
	case ESP_ERR_INVALID_ARG:
	case ESP_ERR_INVALID_STATE:
		return -EINVAL;
	case ESP_ERR_NO_MEM:
		return -ENOMEM;
	case ESP_ERR_NOT_FOUND:
		return -ENODEV;
	case ESP_ERR_TIMEOUT:
		return -ETIMEDOUT;
	case ESP_ERR_NOT_SUPPORTED:
		return -ENOTSUP;
	default:
		return -EIO;
	}
}

static int setup_battery_adc(void)
{
	uint32_t clock_src_hz = 0;
	adc_oneshot_hal_chan_cfg_t channel_cfg = {
		.atten = BATTERY_ADC_ATTEN,
		.bitwidth = BATTERY_ADC_BITWIDTH,
	};
	adc_cali_line_fitting_config_t cali_cfg = {
		.unit_id = BATTERY_ADC_UNIT,
		.atten = BATTERY_ADC_ATTEN,
		.bitwidth = BATTERY_ADC_BITWIDTH,
#if CONFIG_IDF_TARGET_ESP32
		.default_vref = BATTERY_ADC_DEFAULT_VREF_MV,
#endif
	};
	esp_err_t err;

	err = esp_clk_tree_src_get_freq_hz(ADC_DIGI_CLK_SRC_DEFAULT,
					   ESP_CLK_TREE_SRC_FREQ_PRECISION_CACHED,
					   &clock_src_hz);
	if (err != ESP_OK) {
		LOG_WRN("battery ADC clock setup failed: 0x%x", err);
		return esp_err_to_errno(err);
	}

	adc_oneshot_hal_cfg_t hal_cfg = {
		.unit = BATTERY_ADC_UNIT,
		.work_mode = ADC_HAL_SINGLE_READ_MODE,
		.clk_src = ADC_DIGI_CLK_SRC_DEFAULT,
		.clk_src_freq_hz = clock_src_hz,
	};

	adc_oneshot_hal_init(&battery_adc_hal, &hal_cfg);
	adc_oneshot_hal_channel_config(&battery_adc_hal, &channel_cfg,
				       BATTERY_ADC_CHANNEL);
	sar_periph_ctrl_adc_oneshot_power_acquire();

	err = adc_cali_create_scheme_line_fitting(&cali_cfg, &battery_adc_cali);
	if (err == ESP_OK) {
		battery_calibrated = true;
	} else {
		LOG_WRN("battery ADC calibration unavailable: 0x%x", err);
	}

	battery_ready = true;
	LOG_INF("battery voltage monitor ready: ESP HAL ADC1 channel 6 (IO34), "
		"12 dB attenuation, calibration %s, clock %u Hz",
		battery_calibrated ? "enabled" : "unavailable", clock_src_hz);
	return 0;
}

int tracker_power_monitor_init(void)
{
	return setup_battery_adc();
}

int tracker_power_monitor_read_battery_sample(struct tracker_battery_sample *sample)
{
	int raw_sample;
	int32_t pin_mv;
	int64_t scaled_mv;
	esp_err_t err;

	if (sample == NULL) {
		return -EINVAL;
	}

	memset(sample, 0, sizeof(*sample));
	sample->battery_mv = TRACKER_BATTERY_MV_INVALID;
	sample->pin_mv = TRACKER_BATTERY_MV_INVALID;

	if (!battery_ready) {
		return -ENODEV;
	}

	adc_oneshot_hal_setup(&battery_adc_hal, BATTERY_ADC_CHANNEL);
#if SOC_ADC_CALIBRATION_V1_SUPPORTED
	adc_set_hw_calibration_code(BATTERY_ADC_UNIT, BATTERY_ADC_ATTEN);
#endif
	if (!adc_oneshot_hal_convert(&battery_adc_hal, &raw_sample)) {
		return -EIO;
	}
	if (raw_sample < 0 || raw_sample > UINT16_MAX) {
		return -ERANGE;
	}
	sample->raw = (uint16_t)raw_sample;
	sample->raw_valid = true;

	if (!battery_calibrated) {
		return 0;
	}

	err = adc_cali_raw_to_voltage(battery_adc_cali, raw_sample, &pin_mv);
	if (err != ESP_OK) {
		return esp_err_to_errno(err);
	}

	if (pin_mv < 0 || pin_mv > UINT16_MAX) {
		return -ERANGE;
	}

	sample->pin_mv = (uint16_t)pin_mv;
	sample->pin_mv_valid = true;

	scaled_mv = ((int64_t)pin_mv * BATTERY_DIVIDER_NUMERATOR +
		     (BATTERY_DIVIDER_DENOMINATOR / 2)) /
		    BATTERY_DIVIDER_DENOMINATOR;
	if (scaled_mv < 0 || scaled_mv > UINT16_MAX) {
		return -ERANGE;
	}

	sample->battery_mv = (uint16_t)scaled_mv;
	sample->battery_mv_valid = true;
	return 0;
}

int tracker_power_monitor_read_battery_mv(uint16_t *battery_mv)
{
	struct tracker_battery_sample sample;
	int ret;

	if (battery_mv == NULL) {
		return -EINVAL;
	}

	*battery_mv = TRACKER_BATTERY_MV_INVALID;

	ret = tracker_power_monitor_read_battery_sample(&sample);
	if (ret != 0) {
		return ret;
	}
	if (!sample.battery_mv_valid) {
		return sample.saturated ? -ERANGE : -ENODATA;
	}

	*battery_mv = sample.battery_mv;
	return 0;
}
```

## src/settings.c
```c
#include <app/settings.h>

#include <errno.h>
#include <string.h>

#include <zephyr/logging/log.h>
#include <zephyr/settings/settings.h>
#include <zephyr/sys/util.h>

#if IS_ENABLED(CONFIG_SHELL)
#include <zephyr/shell/shell.h>
#endif

LOG_MODULE_REGISTER(tracker_settings, CONFIG_APP_LOG_LEVEL);

#define TRACKER_SETTINGS_SUBTREE "tracker"

#define TRACKER_LORAWAN_DEV_EUI_KEY "lorawan/dev_eui"
#define TRACKER_LORAWAN_JOIN_EUI_KEY "lorawan/join_eui"
#define TRACKER_LORAWAN_APP_KEY_KEY "lorawan/app_key"
#define TRACKER_LORAWAN_IDENTITY_CRC_KEY "lorawan/identity_crc"

#define TRACKER_LORAWAN_DEV_EUI_SETTING \
	TRACKER_SETTINGS_SUBTREE "/" TRACKER_LORAWAN_DEV_EUI_KEY
#define TRACKER_LORAWAN_JOIN_EUI_SETTING \
	TRACKER_SETTINGS_SUBTREE "/" TRACKER_LORAWAN_JOIN_EUI_KEY
#define TRACKER_LORAWAN_APP_KEY_SETTING \
	TRACKER_SETTINGS_SUBTREE "/" TRACKER_LORAWAN_APP_KEY_KEY
#define TRACKER_LORAWAN_IDENTITY_CRC_SETTING \
	TRACKER_SETTINGS_SUBTREE "/" TRACKER_LORAWAN_IDENTITY_CRC_KEY

static const struct tracker_lorawan_settings default_lorawan_settings = {
	.dev_eui = {0x01, 0x23, 0x45, 0x67, 0x89, 0xAB, 0xCD, 0xEF},
	.join_eui = {0x01, 0x23, 0x45, 0x67, 0x89, 0xAB, 0xCD, 0xEF},
	.app_key = {
		0x01, 0x23, 0x45, 0x67, 0x89, 0xAB, 0xCD, 0xEF,
		0x01, 0x23, 0x45, 0x67, 0x89, 0xAB, 0xCD, 0xEF,
	},
	.provisioned = false,
};

static struct tracker_lorawan_settings stored_lorawan_settings;
static bool has_dev_eui;
static bool has_join_eui;
static bool has_app_key;
static bool has_applied_identity_crc;
static uint32_t applied_identity_crc;

static const char *const lorawan_nvm_keys[] = {
	"lorawan/nvm/Crypto",
	"lorawan/nvm/MacGroup1",
	"lorawan/nvm/MacGroup2",
	"lorawan/nvm/SecureElement",
	"lorawan/nvm/RegionGroup1",
	"lorawan/nvm/RegionGroup2",
	"lorawan/nvm/ClassB",
};

static void tracker_lorawan_reset_loaded_settings(void)
{
	stored_lorawan_settings = default_lorawan_settings;
	has_dev_eui = false;
	has_join_eui = false;
	has_app_key = false;
	has_applied_identity_crc = false;
	applied_identity_crc = 0;
}

static int read_exact_setting(settings_read_cb read_cb, void *cb_arg, void *dst,
			      size_t expected_len, size_t stored_len,
			      const char *name)
{
	ssize_t bytes_read;

	if (stored_len != expected_len) {
		LOG_WRN("ignoring %s: expected %zu bytes, found %zu", name,
			expected_len, stored_len);
		return -EINVAL;
	}

	bytes_read = read_cb(cb_arg, dst, expected_len);
	if (bytes_read < 0) {
		return (int)bytes_read;
	}

	if (bytes_read != expected_len) {
		LOG_WRN("ignoring %s: short read %zd/%zu", name, bytes_read,
			expected_len);
		return -EINVAL;
	}

	return 0;
}

static int tracker_settings_handle_set(const char *name, size_t len,
				       settings_read_cb read_cb, void *cb_arg)
{
	int ret;

	if (strcmp(name, TRACKER_LORAWAN_DEV_EUI_KEY) == 0) {
		ret = read_exact_setting(read_cb, cb_arg,
					 stored_lorawan_settings.dev_eui,
					 sizeof(stored_lorawan_settings.dev_eui),
					 len, name);
		if (ret == 0) {
			has_dev_eui = true;
		}

		return 0;
	}

	if (strcmp(name, TRACKER_LORAWAN_JOIN_EUI_KEY) == 0) {
		ret = read_exact_setting(read_cb, cb_arg,
					 stored_lorawan_settings.join_eui,
					 sizeof(stored_lorawan_settings.join_eui),
					 len, name);
		if (ret == 0) {
			has_join_eui = true;
		}

		return 0;
	}

	if (strcmp(name, TRACKER_LORAWAN_APP_KEY_KEY) == 0) {
		ret = read_exact_setting(read_cb, cb_arg,
					 stored_lorawan_settings.app_key,
					 sizeof(stored_lorawan_settings.app_key),
					 len, name);
		if (ret == 0) {
			has_app_key = true;
		}

		return 0;
	}

	if (strcmp(name, TRACKER_LORAWAN_IDENTITY_CRC_KEY) == 0) {
		ret = read_exact_setting(read_cb, cb_arg, &applied_identity_crc,
					 sizeof(applied_identity_crc), len, name);
		if (ret == 0) {
			has_applied_identity_crc = true;
		}

		return 0;
	}

	LOG_WRN("unknown tracker setting: %s", name);
	return 0;
}

SETTINGS_STATIC_HANDLER_DEFINE(tracker, TRACKER_SETTINGS_SUBTREE, NULL,
			       tracker_settings_handle_set, NULL, NULL);

bool tracker_lorawan_settings_is_provisioned(void)
{
	return has_dev_eui && has_join_eui && has_app_key;
}

void tracker_lorawan_settings_get(struct tracker_lorawan_settings *settings)
{
	if (settings == NULL) {
		return;
	}

	if (tracker_lorawan_settings_is_provisioned()) {
		*settings = stored_lorawan_settings;
		settings->provisioned = true;
		return;
	}

	*settings = default_lorawan_settings;
}

static uint32_t fnv1a32_update(uint32_t hash, const uint8_t *data, size_t len)
{
	for (size_t i = 0; i < len; i++) {
		hash ^= data[i];
		hash *= 16777619U;
	}

	return hash;
}

static uint32_t tracker_lorawan_identity_crc(
	const struct tracker_lorawan_settings *settings)
{
	uint32_t hash = 2166136261U;

	hash = fnv1a32_update(hash, settings->dev_eui, sizeof(settings->dev_eui));
	hash = fnv1a32_update(hash, settings->join_eui, sizeof(settings->join_eui));
	hash = fnv1a32_update(hash, settings->app_key, sizeof(settings->app_key));

	return hash;
}

static int remember_first_error(int current, int next)
{
	return current == 0 ? next : current;
}

static int tracker_lorawan_clear_nvm(void)
{
	int ret = 0;

	for (size_t i = 0; i < ARRAY_SIZE(lorawan_nvm_keys); i++) {
		int key_ret = settings_delete(lorawan_nvm_keys[i]);

		if (key_ret != 0) {
			LOG_WRN("failed to delete %s: %d", lorawan_nvm_keys[i],
				key_ret);
			ret = remember_first_error(ret, key_ret);
		}
	}

	return ret;
}

static int tracker_lorawan_prepare_identity(void)
{
	uint32_t identity_crc;
	int ret;
	int save_ret;

	if (!tracker_lorawan_settings_is_provisioned()) {
		LOG_WRN("LoRaWAN identity is not provisioned; using development fallback");
		return 0;
	}

	identity_crc = tracker_lorawan_identity_crc(&stored_lorawan_settings);
	if (has_applied_identity_crc && applied_identity_crc == identity_crc) {
		LOG_INF("LoRaWAN identity loaded from tracker settings");
		return 0;
	}

	LOG_INF("LoRaWAN identity changed; clearing stored LoRaWAN session state");
	ret = tracker_lorawan_clear_nvm();

	save_ret = settings_save_one(TRACKER_LORAWAN_IDENTITY_CRC_SETTING,
				     &identity_crc, sizeof(identity_crc));
	if (save_ret != 0) {
		LOG_WRN("failed to save LoRaWAN identity marker: %d", save_ret);
		ret = remember_first_error(ret, save_ret);
	} else {
		applied_identity_crc = identity_crc;
		has_applied_identity_crc = true;
	}

	return ret;
}

int tracker_settings_init(void)
{
	int ret;

	tracker_lorawan_reset_loaded_settings();

	ret = settings_subsys_init();
	if (ret != 0) {
		LOG_ERR("settings subsystem init failed: %d", ret);
		return ret;
	}

	ret = settings_load_subtree(TRACKER_SETTINGS_SUBTREE);
	if (ret != 0) {
		LOG_ERR("tracker settings load failed: %d", ret);
		return ret;
	}

	return tracker_lorawan_prepare_identity();
}

int tracker_lorawan_settings_save(const struct tracker_lorawan_settings *settings)
{
	int ret;

	if (settings == NULL) {
		return -EINVAL;
	}

	ret = settings_save_one(TRACKER_LORAWAN_DEV_EUI_SETTING,
				settings->dev_eui, sizeof(settings->dev_eui));
	if (ret != 0) {
		return ret;
	}

	ret = settings_save_one(TRACKER_LORAWAN_JOIN_EUI_SETTING,
				settings->join_eui, sizeof(settings->join_eui));
	if (ret != 0) {
		return ret;
	}

	ret = settings_save_one(TRACKER_LORAWAN_APP_KEY_SETTING,
				settings->app_key, sizeof(settings->app_key));
	if (ret != 0) {
		return ret;
	}

	stored_lorawan_settings = *settings;
	stored_lorawan_settings.provisioned = true;
	has_dev_eui = true;
	has_join_eui = true;
	has_app_key = true;

	return tracker_lorawan_prepare_identity();
}

int tracker_lorawan_settings_clear(void)
{
	int ret = 0;

	ret = remember_first_error(ret, settings_delete(TRACKER_LORAWAN_DEV_EUI_SETTING));
	ret = remember_first_error(ret, settings_delete(TRACKER_LORAWAN_JOIN_EUI_SETTING));
	ret = remember_first_error(ret, settings_delete(TRACKER_LORAWAN_APP_KEY_SETTING));
	ret = remember_first_error(ret,
				   settings_delete(TRACKER_LORAWAN_IDENTITY_CRC_SETTING));
	ret = remember_first_error(ret, tracker_lorawan_clear_nvm());

	tracker_lorawan_reset_loaded_settings();

	return ret;
}

#if IS_ENABLED(CONFIG_SHELL)
static int parse_hex_arg(const char *arg, uint8_t *dst, size_t dst_len)
{
	if (strlen(arg) != dst_len * 2) {
		return -EINVAL;
	}

	if (hex2bin(arg, strlen(arg), dst, dst_len) != dst_len) {
		return -EINVAL;
	}

	return 0;
}

static int cmd_tracker_provision_status(const struct shell *shell, size_t argc,
					char **argv)
{
	ARG_UNUSED(argc);
	ARG_UNUSED(argv);

	struct tracker_lorawan_settings settings;
	char dev_eui[(TRACKER_LORAWAN_EUI_LEN * 2) + 1];
	char join_eui[(TRACKER_LORAWAN_EUI_LEN * 2) + 1];

	tracker_lorawan_settings_get(&settings);
	(void)bin2hex(settings.dev_eui, sizeof(settings.dev_eui), dev_eui,
		      sizeof(dev_eui));
	(void)bin2hex(settings.join_eui, sizeof(settings.join_eui), join_eui,
		      sizeof(join_eui));

	shell_print(shell, "LoRaWAN identity: %s",
		    settings.provisioned ? "provisioned" : "development fallback");
	shell_print(shell, "DevEUI: %s", dev_eui);
	shell_print(shell, "JoinEUI: %s", join_eui);
	shell_print(shell, "AppKey: %s",
		    settings.provisioned ? "set" : "development fallback");

	return 0;
}

static int cmd_tracker_provision_set(const struct shell *shell, size_t argc,
				     char **argv)
{
	ARG_UNUSED(argc);

	struct tracker_lorawan_settings settings = {
		.provisioned = true,
	};
	int ret;

	ret = parse_hex_arg(argv[1], settings.dev_eui, sizeof(settings.dev_eui));
	if (ret != 0) {
		shell_error(shell, "DevEUI must be 16 hex characters");
		return -EINVAL;
	}

	ret = parse_hex_arg(argv[2], settings.join_eui, sizeof(settings.join_eui));
	if (ret != 0) {
		shell_error(shell, "JoinEUI must be 16 hex characters");
		return -EINVAL;
	}

	ret = parse_hex_arg(argv[3], settings.app_key, sizeof(settings.app_key));
	if (ret != 0) {
		shell_error(shell, "AppKey must be 32 hex characters");
		return -EINVAL;
	}

	ret = tracker_lorawan_settings_save(&settings);
	if (ret != 0) {
		shell_error(shell, "failed to save LoRaWAN identity: %d", ret);
		return -ENOEXEC;
	}

	shell_print(shell, "LoRaWAN identity saved; reboot the tracker to apply it");
	return 0;
}

static int cmd_tracker_provision_clear(const struct shell *shell, size_t argc,
				       char **argv)
{
	ARG_UNUSED(argc);
	ARG_UNUSED(argv);

	int ret = tracker_lorawan_settings_clear();

	if (ret != 0) {
		shell_error(shell, "failed to clear LoRaWAN identity: %d", ret);
		return -ENOEXEC;
	}

	shell_print(shell, "LoRaWAN identity cleared; reboot the tracker to apply fallback");
	return 0;
}

SHELL_STATIC_SUBCMD_SET_CREATE(
	tracker_provision_cmds,
	SHELL_CMD_ARG(status, NULL, "Show provisioned LoRaWAN identity status",
		      cmd_tracker_provision_status, 1, 0),
	SHELL_CMD_ARG(set, NULL,
		      "Set LoRaWAN OTAA identity: <dev_eui> <join_eui> <app_key>",
		      cmd_tracker_provision_set, 4, 0),
	SHELL_CMD_ARG(clear, NULL, "Delete provisioned LoRaWAN identity",
		      cmd_tracker_provision_clear, 1, 0),
	SHELL_SUBCMD_SET_END);

SHELL_STATIC_SUBCMD_SET_CREATE(
	tracker_cmds,
	SHELL_CMD(provision, &tracker_provision_cmds,
		  "Tracker provisioning commands", NULL),
	SHELL_SUBCMD_SET_END);

SHELL_CMD_REGISTER(tracker, &tracker_cmds, "Tracker commands", NULL);
#endif
```

## boards/dragino/trackerd_ls/Kconfig
```kconfig
config HEAP_MEM_POOL_ADD_SIZE_BOARD
	int
	default 4096 if BOARD_TRACKERD_LS_ESP32_PROCPU
	default 256 if BOARD_TRACKERD_LS_ESP32_APPCPU
```

## boards/dragino/trackerd_ls/board.yml
```yaml
board:
  name: trackerd_ls
  full_name: TrackerD-LS
  vendor: dragino
  socs:
    - name: esp32
```

## drivers/led_status/Kconfig
```kconfig
# Copyright (c) 2024 Nordic Semiconductor ASA
# SPDX-License-Identifier: Apache-2.0

menuconfig LED_STATUS
	bool "Blinking status LED device drivers"
	help
	  This option enables the blinking status LED custom driver class.

if LED_STATUS

config LED_STATUS_INIT_PRIORITY
	int "Blink status LED device drivers init priority"
	default KERNEL_INIT_PRIORITY_DEVICE
	help
	  Blinking status LED device drivers init priority.

module = LED_STATUS
module-str = led_status
source "subsys/logging/Kconfig.template.log_config"

rsource "Kconfig.gpio_led"

endif # BLINK
```

## drivers/led_status/Kconfig.gpio_led
```kconfig
# Copyright (c) 2024 Nordic Semiconductor ASA
# SPDX-License-Identifier: Apache-2.0

config LED_STATUS_GPIO
	bool "GPIO-controlled blinking status LED driver"
	default y
	depends on DT_HAS_LED_STATUS_GPIO_ENABLED
	select GPIO
	help
	  Enable this option to use the GPIO-controlled status LED blink driver.
```

## dts/bindings/gnss/gnss-nmea-generic-gpio.yaml
```yaml
# Copyright (c) 2021 Nordic Semiconductor ASA
# SPDX-License-Identifier: Apache-2.0
description: |
  Generic GNSS NMEA receiver

  Implement a generic NMEA based GNSS device.

  Example configuration:

  &uart0 {
          current-speed = <9600>;
          ...
          gnss: gnss-nmea-generic-switched {
                  compatible = "gnss-nmea-generic-switched";
                  gpio-power = <&gpio0 12 GPIO_ACTIVE_HIGH>;
                  gpio-reset = <&gpio0 25 GPIO_ACTIVE_LOW>;
          };
  };

compatible: "gnss-nmea-generic-gpio"

include:
  - uart-device.yaml

properties:
  power-gpios:
    type: phandle-array
    description: Pin controlling VSS power supply
  reset-gpios:
    type: phandle-array
    description: Reset pin
```

## dts/bindings/led_status/led-status-gpio.yaml
```yaml
# Copyright (c) 2024 Nordic Semiconductor ASA
# SPDX-License-Identifier: Apache-2.0

description: |
  A generic binding for a GPIO-controlled blinking LED. Note that this binding
  has no vendor prefix, as it does not target a specific device or vendor.

  Example definition in devicetree:

    led-status-gpio {
        compatible = "led-status-gpio";
        gpios = <&gpio0 0 GPIO_ACTIVE_HIGH>;
        blink-period-ms = <1000>;
    };

compatible: "led-status-gpio"

include: base.yaml

properties:
  gpios:
    type: phandle-array
    required: true
    description: GPIO-controlled LED.
```

## lib/Kconfig
```kconfig
# Copyright (c) 2021 Legrand North America, LLC.
# SPDX-License-Identifier: Apache-2.0

menu "Custom libraries"

rsource "gnss/Kconfig"
rsource "lorawan_node/Kconfig"

endmenu
```

## lib/gnss/Kconfig
```kconfig
# Copyright (c) 2021, Legrand North America, LLC.
# SPDX-License-Identifier: Apache-2.0

module = APP_GNSS
module-str = app_gnss
source "subsys/logging/Kconfig.template.log_config"
```

## lib/led_status/Kconfig
```kconfig
# Copyright (c) 2021, Legrand North America, LLC.
# SPDX-License-Identifier: Apache-2.0

module = APP_LED_STATUS
module-str = app_led_status
source "subsys/logging/Kconfig.template.log_config"
```

## lib/lorawan_node/Kconfig
```kconfig
# Copyright (c) 2021, Legrand North America, LLC.
# SPDX-License-Identifier: Apache-2.0

module = APP_LORAWAN_NODE
module-str = app_lorawan_node
source "subsys/logging/Kconfig.template.log_config"
```
